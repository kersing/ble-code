## CMakeLists.txt
```
# SPDX-License-Identifier: Apache-2.0

cmake_minimum_required(VERSION 3.20.0)
find_package(Zephyr REQUIRED HINTS $ENV{ZEPHYR_BASE})
project(advertise-adc)

target_sources(app PRIVATE src/lmt86.c src/main.c)
```

## prj.conf
```kconfig
CONFIG_BT=y
CONFIG_BT_DEBUG_LOG=y
CONFIG_BT_DEVICE_NAME="ADC beacon"
CONFIG_ADC=y
CONFIG_ADC_ASYNC=y
```

## boards/xiao_ble.overlay
```dts
/*
 * SPDX-License-Identifier: Apache-2.0
 *
 * Copyright (c) 2022 Nordic Semiconductor ASA
 */


/ {
	zephyr,user {
		io-channels = <&adc 0>;
	};
};

&adc {
	#address-cells = <1>;
	#size-cells = <0>;

	channel@0 {
		reg = <0>;
		zephyr,gain = "ADC_GAIN_1_6";
		zephyr,reference = "ADC_REF_INTERNAL";
		zephyr,acquisition-time = <ADC_ACQ_TIME_DEFAULT>;
		zephyr,input-positive = <NRF_SAADC_AIN1>; /* P0.03 */
		zephyr,resolution = <12>;
	};
};
```

## src/main.c
```c
/*
 * Advertise LMT86 temperature data 
 *
 * Copyright (c) 2023 The-Box Development
 * Based on an example by Koen Vervloesem 
 *
 * SPDX-License-Identifier: MIT
 */

#include <stddef.h>
#include <stdio.h>
#include <zephyr/bluetooth/bluetooth.h>
#include <zephyr/bluetooth/hci.h>
#include <zephyr/drivers/adc.h>
#include <zephyr/sys/printk.h>
#include <zephyr/sys/util.h>
#include <zephyr/types.h>

#include "lmt86.h"

#define ADV_PARAM                                                    \
  BT_LE_ADV_PARAM(0, BT_GAP_ADV_SLOW_INT_MIN,                        \
                  BT_GAP_ADV_SLOW_INT_MAX, NULL)

static struct bt_data advertisement[] = 
{
    BT_DATA_BYTES(BT_DATA_FLAGS, BT_LE_AD_NO_BREDR),
    BT_DATA_BYTES(
        BT_DATA_MANUFACTURER_DATA, 0xff, 0xff, /* Test company ID */
        0x00, 0x00, 0x00 /* Temperature, packed bcd encoded (because we can) */
    )
};

void update_data(const struct adc_dt_spec *d) 
{
  int16_t temp;
  char s[4];

  temp = lmt86_get_temperature(d);
  // Use binary format for maximum efficiency when using other software to process
  // memcpy(&(advertisement[1].data[2]), &temp, 2);

  // Put it in BCD format for easy human consumption in nRF explorer
  if (temp < 0)
  {
	  s[0] = '-';
	  temp = 0 - temp;
  }
  else
  {
	  s[0]= 0;
  }

  // Limit range to 4 digit
  temp = temp % 10000;

  s[1]= ( temp / 1000 ) << 4; 
  temp = temp % 1000;
  s[1]= s[1] | ( temp / 100 );
  temp = temp % 100;
  s[2]= ( temp / 10 ) << 4; 
  temp = temp % 10;
  s[2]= s[2] | ( temp );
  s[3]= '\0';
  memcpy(&(advertisement[1].data[2]), &s, 3);
}

void main(void) 
{
  int err;

  printk("Startup\n");

  // Get ADC device
  const struct adc_dt_spec *lmt86 = get_device_lmt86();

  if (lmt86 == NULL) 
  {
    printk("Failed to get ADC device\n");
    return;
  }

  // Initialize the Bluetooth subsystem
  err = bt_enable(NULL);
  if (err) 
  {
    printk("Bluetooth initialize failed (%d)\n", err);
    return;
  }

  printk("Bluetooth init done\n");

  // Start advertising sensor values
  update_data(lmt86);
  err = bt_le_adv_start(ADV_PARAM, advertisement, ARRAY_SIZE(advertisement), NULL, 0);

  if (err) 
  {
    printk("Advertising start failed (%d)\n", err);
    return;
  }

  while (1) 
  {
    k_sleep(K_MSEC(970));
    update_data(lmt86);
    err = bt_le_adv_update_data(advertisement, ARRAY_SIZE(advertisement), NULL, 0);

    if (err) 
    {
      printk("Advertising data update failed (%d)\n", err);
      return;
    }
  }
}
```

## src/lmt86.c
```c
/*
 *
 * LMT86 
 *
 * Copyright (c) 2023 The-Box Development
 *
 * SPDX-License-Identifier: MIT
 *
 */

#include <inttypes.h>
#include <stddef.h>
#include <stdint.h>

#include <zephyr/device.h>
#include <zephyr/devicetree.h>
#include <zephyr/drivers/adc.h>
#include <zephyr/kernel.h>
#include <zephyr/sys/printk.h>
#include <zephyr/sys/util.h>

#include "lmt86.h"

const struct adc_dt_spec *get_device_lmt86()
{
	int err;
	const static struct adc_dt_spec d = ADC_DT_SPEC_GET_BY_IDX(DT_PATH(zephyr_user), 0);

	if (!device_is_ready(d.dev)) {
                        printk("ADC controller device not ready\n");
                        return NULL;
	}

	err = adc_channel_setup_dt(&d);
	if (err < 0) {
		printk("Could not setup adc channel (%d)\n", err);
		return NULL;
	}

	return &d;
}

int16_t lmt86_get_temperature(const struct adc_dt_spec *d)
{
	int err;
	int16_t buf;
	int32_t val_mv;
	float t;
	struct adc_sequence sequence = {
                .buffer = &buf,
                /* buffer size in bytes, not number of samples */
                .buffer_size = sizeof(buf),
        };

	printk("ADC reading:\n");
        (void)adc_sequence_init_dt(d, &sequence);

        err = adc_read(d->dev, &sequence);
        if (err < 0) {
               printk("Could not read (%d)\n", err);
        } else {
               printk("%"PRId16, buf);
        }

	/* conversion to mV may not be supported, skip if not */
	val_mv = buf;
	err = adc_raw_to_millivolts_dt(d,
				      &val_mv);
	if (err < 0) {
		printk(" (value in mV not available)\n");
	} else {
		printk(" = %"PRId32" mV\n", val_mv);
	}

	/* translation from mV to temperature */
	t = 5.0 + (( val_mv - 2047 ) / - 10.8 );
	t = t * 10;

	return (int) t;
}
```

## src/lmt86.h
```c
/*
 *
 * LMT86 interface
 *
 * Copyright (c) 2023 The-Box Development
 *
 * SPDX-License-Identifier: MIT
 *
 */

#ifndef __LMT86__H
#define __LMT86__H

const struct adc_dt_spec *get_device_lmt86();
int16_t lmt86_get_temperature(const struct adc_dt_spec *d);
#endif
```
